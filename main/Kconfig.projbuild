## main/Kconfig.projbuild
```kconfig
menu "WiFi Config Menu"

    config ESP_WIFI_SSID
        string  "SSID"
        default "realme C12"
        help
            SSID.

    config ESP_WIFI_PASSWORD
        string  "PASSWORD"
        default  "beba93bf865e"
        help 
            PASSWORD.

    config ESP_MAXIMUM_RETRY
        int "Maximum retry"
        default 10
        help
            Set the Maximum retry to avoid station reconnecting to the AP unlimited when the AP is really inexistent.

endmenu
```
